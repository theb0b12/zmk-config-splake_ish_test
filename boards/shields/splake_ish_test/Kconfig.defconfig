## boards/shields/splake_ish_test/Kconfig.shield
```kconfig
config SHIELD_SPLAKE_ISH_TEST_LEFT
    def_bool $(shields_list_contains,splake_ish_test_left)

config SHIELD_SPLAKE_ISH_TEST_RIGHT
    def_bool $(shields_list_contains,splake_ish_test_right)
```
